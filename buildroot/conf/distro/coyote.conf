## buildroot/conf/distro/coyote.conf
```bitbake
#############################################################################
#@TYPE: Distribution
#@NAME: Coyote
#@DESCRIPTION: Coyote Linux Distribution Configuration
#
#@COMMENT: This distribution configuration is used for Coyote Linux v4
#############################################################################

DISTRO_NAME = "coyote"
#DISTRO_VERSION = ".dev-snapshot-${SRCDATE}"
DISTRO_VERSION="4.0b1"
DISTRO_TYPE = "release"
#DISTRO_TYPE = "debug"

#PR = "1"

# Ensure some form of release config, so error out if someone thinks he knows better
DISTRO_CHECK := "${@bb.data.getVar("DISTRO_VERSION",d,1) or bb.fatal('Remove this line or set a dummy DISTRO_VERSION")

DISTRO_FEATURES = "ext2 squashfs"

INHERIT += "debian"

INHERIT += "packaged-staging"

# Chose the packaging system
INHERIT += "package_ipk"
IMAGE_FSTYPES = "tar.gz"

require conf/distro/include/sane-feed.inc
PREFERRED_PKG_FORMAT ?= "ipk"
require conf/distro/include/sane-feed-${PREFERRED_PKG_FORMAT}.inc

# If we're using an .ipk based rootfs, we want to have opkg-nogpg installed so postinst script can run
IPKG_VARIANT = "opkg-nogpg"

#############################################################################
# IMAGES
#############################################################################
# Name the generated images in a sane way
IMAGE_NAME = "${DISTRO_NAME}-${IMAGE_BASENAME}-${PREFERRED_LIBC}-${PREFERRED_PKG_FORMAT}-${DISTRO_VERSION}-${MACHINE}"
CACHE ?= "${TMPDIR}/cache/${PREFERRED_LIBC}/${MACHINE}"
DEPLOY_DIR ?= "${TMPDIR}/deploy/${PREFERRED_LIBC}"
DEPLOY_DIR_IMAGE = "${DEPLOY_DIR}/images/${MACHINE}"

KERNEL = "kernel26"
MACHINE_KERNEL_VERSION = "2.6.29"

#############################################################################
# TOOLCHAIN
#############################################################################
PREFERRED_LIBC = "glibc"

require conf/distro/include/sane-toolchain.inc

PREFERRED_PROVIDER_task-bootstrap = "task-bootstrap"
PREFERRED_PROVIDER_virtual/db = "db3"
PREFERRED_PROVIDER_virtual/db-native = "db3-native"


#PREFERRED_PROVIDER_avahi = "avahi"
#PREFERRED_PROVIDER_gconf = "gconf-dbus"
#PREFERRED_PROVIDER_gtk+ = "gtk+"
#PREFERRED_PROVIDER_libgpewidget = "libgpewidget"
#PREFERRED_PROVIDER_virtual/libsdl = "libsdl-x11"
PREFERRED_PROVIDER_virtual/libx11 = "diet-x11"

#############################################################################
# PREFERRED VERSIONS
#############################################################################

require conf/distro/include/sane-srcdates.inc
require conf/distro/include/sane-srcrevs.inc

#require conf/distro/include/preferred-e-versions.inc
#require conf/distro/include/preferred-xorg-versions-X11R7.4-updates.inc
#require conf/distro/include/preferred-xorg-versions-X11R7.4.inc

PREFERED_VERSION_mono = "1.2.6"
#PREFERRED_VERSION_mono = "1.9.1+2.2-rc1"
#PREFERRED_VERSION_mono = "svn"

PREFERRED_VERSION_glibc = "2.5"
PREFERRED_VERSION_glibc-initial = "2.5"

PREFERRED_VERSION_binutils = "2.17.50.0.8"
PREFERRED_VERSION_binutils-initial = "2.17.50.0.8"

PREFERRED_VERSION_gcc = "4.1.2"
PREFERRED_VERSION_gcc-initial = "4.1.2"

PREFERRED_VERSION_linux = "2.6.29"


#############################################################################
# CONTENTS
#############################################################################

# Ship extra debug utils in the rootfs when doing a debug build 
#DISTRO_EXTRA_APPS ?= ""
#DISTRO_EXTRA_APPS += '${@base_conditional("DISTRO_TYPE", "release", "", "task-cli-tools-debug",d)}'
```
